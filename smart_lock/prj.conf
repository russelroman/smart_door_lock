## prj.conf
```kconfig
#
# Copyright (c) 2018 Nordic Semiconductor
#
# SPDX-License-Identifier: LicenseRef-Nordic-5-Clause
#

# Logger module
CONFIG_LOG=y

# Button and LED library
CONFIG_GPIO=y
#CONFIG_DK_LIBRARY=y

# Bluetooth LE
CONFIG_BT=y
CONFIG_BT_PERIPHERAL=y
CONFIG_BT_GATT_CLIENT=y     # To resolve bt_gatt_exchange_mtu() link error
CONFIG_BT_DEVICE_NAME="Lock"

# Increase stack size for the main thread and System Workqueue
CONFIG_SYSTEM_WORKQUEUE_STACK_SIZE=2048
CONFIG_MAIN_STACK_SIZE=2048

CONFIG_BT_SMP=y
CONFIG_BT_SMP_APP_PAIRING_ACCEPT=y

# For Bonding
CONFIG_SETTINGS=y
CONFIG_BT_SETTINGS=y
CONFIG_FLASH=y
CONFIG_FLASH_PAGE_LAYOUT=y
CONFIG_FLASH_MAP=y
CONFIG_NVS=y

CONFIG_BT_FILTER_ACCEPT_LIST=y
CONFIG_BT_PRIVACY=y
CONFIG_BT_MAX_PAIRED=5

# Dependencies for APP_EVENT_MANAGER and CAF
CONFIG_HEAP_MEM_POOL_SIZE=2048

# Enable CAF_BUTTONS
CONFIG_CAF=y
CONFIG_CAF_BUTTONS=y
CONFIG_CAF_BUTTONS_POLARITY_INVERSED=y

CONFIG_NEWLIB_LIBC=y

CONFIG_BT_BAS=y

CONFIG_BT_PERIPHERAL_PREF_MIN_INT=800
CONFIG_BT_PERIPHERAL_PREF_MAX_INT=800
CONFIG_BT_PERIPHERAL_PREF_LATENCY=0
CONFIG_BT_PERIPHERAL_PREF_TIMEOUT=400
CONFIG_BT_GAP_AUTO_UPDATE_CONN_PARAMS=y

CONFIG_BT_USER_PHY_UPDATE=y

CONFIG_BT_USER_DATA_LEN_UPDATE=y
CONFIG_BT_CTLR_DATA_LENGTH_MAX=251
CONFIG_BT_BUF_ACL_RX_SIZE=251
CONFIG_BT_BUF_ACL_TX_SIZE=251
CONFIG_BT_L2CAP_TX_MTU=247
```

## src/main.c
```c
/*
 * Copyright (c) 2023 Nordic Semiconductor ASA
 *
 * SPDX-License-Identifier: LicenseRef-Nordic-5-Clause
 */

#include <zephyr/kernel.h>
#include <zephyr/logging/log.h>
#include <zephyr/bluetooth/bluetooth.h>
#include <zephyr/bluetooth/gap.h>
#include <zephyr/bluetooth/uuid.h>
#include <zephyr/bluetooth/conn.h>
#include <zephyr/settings/settings.h>
#include <zephyr/device.h>
#include <zephyr/drivers/gpio.h>
#include <zephyr/bluetooth/services/bas.h>
#include <math.h>

#include <app_event_manager.h>

#define MODULE main
LOG_MODULE_REGISTER(MODULE);
#include <caf/events/module_state_event.h>

#include "gatt_lock_svc.h"
#include "gap_advertising.h"
#include "gap_connection.h"
#include "security.h"


#define RUN_LED_BLINK_INTERVAL 1000
#define BUTTON_NODE DT_ALIAS(sw4)

K_MSGQ_DEFINE(device_message_queue, sizeof(uint16_t), 10, 2);

struct k_sem my_sem;

K_SEM_DEFINE(my_sem, 0, 1);

int pass_code = 123456;

static uint8_t battery_level = 100;


void keypad_thread(void *, void *, void *)
{
	uint16_t key = 0;

	//err = k_msgq_get(&device_message_queue, &temp, K_FOREVER);
	int err;
	int temp;
	int passkey = 0;

	while(1)
	{
		LOG_INF("Start of Thread");

		k_sem_take(&my_sem, K_FOREVER);

		for(int i = 0; i < 6; ++i)
		{
			err = k_msgq_get(&device_message_queue, &temp, K_FOREVER);

			passkey = (temp - 48) * pow(10, 5 - i) + passkey;

			if(err == 0)
			{
				LOG_INF("Button Pressed: %c", (char)temp);
			}
		}

		if(pass_code == passkey)
		{
			LOG_INF("Correct PIN");
		}
		else
		{
			LOG_INF("Incorrect PIN");
		}

		LOG_INF("Passkey: %d", passkey);
		LOG_INF("Body of Thread");
		//k_sleep(K_MSEC(RUN_LED_BLINK_INTERVAL));
	}
}


K_THREAD_DEFINE(keypad, 1024,
	keypad_thread, NULL, NULL, NULL,
	1, 0, 0);


static const struct gpio_dt_spec button_temp = GPIO_DT_SPEC_GET(BUTTON_NODE, gpios);
static struct gpio_callback button_cb_data;
static bool is_bond_delete = 0;


void button_pressed(const struct device *dev, struct gpio_callback *cb, uint32_t pins)
{
    printk("Button pressed at pin %d\n", button_temp.pin);

	is_bond_delete = true;
}

void simulate_battery_level(void)
{
	if (--battery_level == 0)
	{
		battery_level = 100;
	}

	bt_bas_set_battery_level(battery_level);
}


int main(void)
{
	int err;
	
    if (!device_is_ready(button_temp.port)) {
        printk("Error: button device %s is not ready\n", button_temp.port->name);
        return -1;
    }

    err = gpio_pin_configure_dt(&button_temp, GPIO_INPUT);
    if (err != 0) {
        printk("Error %d: failed to configure %s pin %d\n", err, button_temp.port->name, button_temp.pin);
        return -1;
    }

    err = gpio_pin_interrupt_configure_dt(&button_temp, GPIO_INT_EDGE_TO_ACTIVE);
    if (err != 0) {
        printk("Error %d: failed to configure interrupt on %s pin %d\n", err, button_temp.port->name, button_temp.pin);
        return -1;
    }

    gpio_init_callback(&button_cb_data, button_pressed, BIT(button_temp.pin));
    gpio_add_callback(button_temp.port, &button_cb_data);

    printk("Set up button at %s pin %d\n", button_temp.port->name, button_temp.pin);

	if (app_event_manager_init()) {
		LOG_ERR("Application Event Manager not initialized");
	} else {
		module_set_state(MODULE_STATE_READY);
	}

	simulate_battery_level();

	err = bt_enable(NULL);
	if (err) {
		LOG_ERR("Bluetooth init failed (err %d)\n", err);
		return -1;
	}
	bt_conn_cb_register(&connection_callbacks);

	err = bt_conn_auth_cb_register(&conn_auth_callbacks);
	if (err) {
		LOG_INF("Failed to register authorization callbacks.\n");
		return -1;
	}

	// Restore previous BLE bonds.
	settings_load();

	LOG_INF("Bluetooth initialized\n");

	advetising_start();

	LOG_INF("Advertising successfully started\n");

	uint16_t temp;

	for (;;) {

		if(is_bond_delete == 1)
		{
			is_bond_delete = 0;
			err = bt_unpair(BT_ID_DEFAULT,BT_ADDR_LE_ANY);

			if (err) {
				LOG_INF("Cannot delete bond (err: %d)\n", err);
			} else	{
				LOG_INF("Bond deleted succesfully \n");
			}	
		}	

		k_sleep(K_MSEC(RUN_LED_BLINK_INTERVAL));
	}
}
```

## src/gap_advertising.c
```c
#include <zephyr/bluetooth/bluetooth.h>
#include <zephyr/bluetooth/gap.h>
#include <zephyr/bluetooth/conn.h>
#include <zephyr/logging/log.h>

#include "gatt_lock_svc.h"
#include "gap_advertising.h"


LOG_MODULE_REGISTER(gap_advertising);


#define BT_GAP_ADV_MIN_INTERVAL_STEP_MS		1.6000	
#define BT_GAP_ADV_MS_TO_INTERVAL(ADV_INTERVAL_MS)	((ADV_INTERVAL_MS) * (BT_GAP_ADV_MIN_INTERVAL_STEP_MS))

/* 
   Different minimum and maximum advertising interval
   will add randomness on the advertising interval. Thus,
   will decrease chance of packet collision.
*/
#define BT_GAP_ADV_INTERVAL_VARIATION	10
#define BT_GAP_ADV_INTERVAL_MIN_MS	100
#define BT_GAP_ADV_INTERVAL_MAX_MS	(BT_GAP_ADV_INTERVAL_MIN_MS + BT_GAP_ADV_INTERVAL_VARIATION)	

#define BT_GAP_ADV_INTERVAL_MIN		BT_GAP_ADV_MS_TO_INTERVAL(BT_GAP_ADV_INTERVAL_MIN_MS)
#define BT_GAP_ADV_INTERVAL_MAX		BT_GAP_ADV_MS_TO_INTERVAL(BT_GAP_ADV_INTERVAL_MAX_MS)

#define BT_LE_ADV_CONN_NO_ACCEPT_LIST_OPTIONS																\
			BT_LE_ADV_OPT_CONNECTABLE	|		   /* Connectable Advertising*/							    \
			BT_LE_ADV_OPT_ONE_TIME		|		   /* Advertise one time only*/								\
            BT_LE_ADV_OPT_USE_IDENTITY			   /* Use the identity address at advertister address*/		\

#define BT_LE_ADV_CONN_ACCEPT_LIST_OPTIONS																    \
			BT_LE_ADV_OPT_CONNECTABLE	|		   /* Connectable Advertising*/							    \
			BT_LE_ADV_OPT_ONE_TIME		|		   /* Advertise one time only*/								\
            BT_LE_ADV_OPT_USE_IDENTITY	|		   /* Use the identity address at advertister address*/		\
			BT_LE_ADV_OPT_FILTER_CONN			   /* Use filter accept list */								\

#define BT_LE_ADV_CONN_NO_ACCEPT_LIST  BT_LE_ADV_PARAM(BT_LE_ADV_CONN_NO_ACCEPT_LIST_OPTIONS, 	\
													   BT_GAP_ADV_INTERVAL_MIN , 				\
													   BT_GAP_ADV_INTERVAL_MIN , 				\
													   NULL)

#define BT_LE_ADV_CONN_ACCEPT_LIST BT_LE_ADV_PARAM(BT_LE_ADV_CONN_ACCEPT_LIST_OPTIONS,			\
												   BT_GAP_ADV_INTERVAL_MIN , 					\
	                                               BT_GAP_ADV_INTERVAL_MIN , 				    \
	                                               NULL)

#define DEVICE_NAME CONFIG_BT_DEVICE_NAME
#define DEVICE_NAME_LEN (sizeof(DEVICE_NAME) - 1)


static const struct bt_data ad[] = 
{
	BT_DATA_BYTES(BT_DATA_FLAGS, (BT_LE_AD_GENERAL | BT_LE_AD_NO_BREDR)),
	BT_DATA(BT_DATA_NAME_COMPLETE, DEVICE_NAME, DEVICE_NAME_LEN),
	BT_DATA_BYTES(BT_DATA_UUID128_ALL, BT_UUID_LOCK_VAL),
};


static void setup_accept_list_cb(const struct bt_bond_info *info, void *user_data)
{
	int *bond_cnt = user_data;

	if ((*bond_cnt) < 0) 
	{
		return;
	}

	int err = bt_le_filter_accept_list_add(&info->addr);
	LOG_INF("Added following peer to whitelist: %x %x \n",info->addr.a.val[0],info->addr.a.val[1]);

	if (err) 
	{
		LOG_INF("Cannot add peer to Filter Accept List (err: %d)\n", err);
		(*bond_cnt) = -EIO;
	} 
	else 
	{
		(*bond_cnt)++;
	}
}

static int setup_accept_list(uint8_t local_id)
{
	int err = bt_le_filter_accept_list_clear();

	if (err) 
	{
		LOG_INF("Cannot clear Filter Accept List (err: %d)\n", err);
		return err;
	}

	int bond_cnt = 0;
	bt_foreach_bond(local_id, setup_accept_list_cb, &bond_cnt);

	return bond_cnt;
}

/*
	The accept list is initialized and created
	before advertising.

	Advertising will be performed after disconnection.
	It is not advisable to call bt_le_adv_start() inside
	the disconnect callback. The disconnect callback runs
	on the Bluetooth RX Thread. Thus, the advertising
	must be done using work queues. The work on work queues
	will be performed on the thread context.
*/
void advertise_with_acceptlist(struct k_work *work)
{
	int err=0;
	int allowed_cnt= setup_accept_list(BT_ID_DEFAULT);

	if (allowed_cnt < 0)
	{
		LOG_INF("Acceptlist setup failed (err:%d)\n", allowed_cnt);
	} 
	else 
	{
		if (allowed_cnt == 0)
		{
			LOG_INF("Advertising with no Filter Accept list\n"); 
			err = bt_le_adv_start(BT_LE_ADV_CONN_NO_ACCEPT_LIST, ad, ARRAY_SIZE(ad),
					NULL, 0);
		}
		else 
		{
			LOG_INF("Acceptlist setup number  = %d \n",allowed_cnt);
			err = bt_le_adv_start(BT_LE_ADV_CONN_ACCEPT_LIST, ad, ARRAY_SIZE(ad),
				NULL, 0);	
		}

		if (err) 
		{
		 	LOG_INF("Advertising failed to start (err %d)\n", err);
			return;
		}
		
		LOG_INF("Advertising successfully started\n");
	}
}
K_WORK_DEFINE(advertise_acceptlist_work, advertise_with_acceptlist);

void advetising_start(void)
{
    k_work_submit(&advertise_acceptlist_work);
}
```

## src/gap_advertising.h
```c
#ifndef GAP_ADVERTISING_H_
#define GAP_ADVERTISING_H_

#include <zephyr/kernel.h>

void advertise_with_acceptlist(struct k_work *work);
void advetising_start(void);


#endif  /* GAP_H_ */
```

## src/gap_connection.c
```c
#include <zephyr/bluetooth/bluetooth.h>
#include <zephyr/bluetooth/conn.h>
#include <zephyr/bluetooth/gatt.h>
#include <zephyr/logging/log.h>

#include "gap_advertising.h"
#include "gap_connection.h"


LOG_MODULE_REGISTER(gap_connection);


static void on_connected(struct bt_conn *conn, uint8_t err);
static void on_disconnected(struct bt_conn *conn, uint8_t reason);
static void on_security_changed(struct bt_conn *conn, bt_security_t level,
                                enum bt_security_err err);
static void on_le_param_updated(struct bt_conn *conn, uint16_t interval, uint16_t latency, 
							uint16_t timeout);
static void on_le_phy_updated(struct bt_conn *conn, struct bt_conn_le_phy_info *param);
static void on_le_data_len_updated(struct bt_conn *conn, struct bt_conn_le_data_len_info *info);


static struct bt_gatt_exchange_params exchange_params;
                                
struct bt_conn_cb connection_callbacks = 
{
	.connected = on_connected,
	.disconnected = on_disconnected,
	.security_changed = on_security_changed,
	.le_param_updated = on_le_param_updated,
	.le_phy_updated = on_le_phy_updated,
	.le_data_len_updated = on_le_data_len_updated,
};


void on_le_data_len_updated(struct bt_conn *conn, struct bt_conn_le_data_len_info *info)
{
    uint16_t tx_len     = info->tx_max_len; 
    uint16_t tx_time    = info->tx_max_time;
    uint16_t rx_len     = info->rx_max_len;
    uint16_t rx_time    = info->rx_max_time;

    LOG_INF("Data length updated. Length %d/%d bytes, time %d/%d us", tx_len, rx_len, 
				tx_time, rx_time);
}

static void exchange_func(struct bt_conn *conn, uint8_t att_err,
	struct bt_gatt_exchange_params *params)
{
	LOG_INF("MTU exchange %s", att_err == 0 ? "successful" : "failed");

	if (!att_err) 
	{
		uint16_t payload_mtu = bt_gatt_get_mtu(conn) - 3;   // 3 bytes used for Attribute headers.
		LOG_INF("New MTU: %d bytes", payload_mtu);
	}
}

static void update_mtu(struct bt_conn *conn)
{
    int err;
    exchange_params.func = exchange_func;

    err = bt_gatt_exchange_mtu(conn, &exchange_params);
    if (err) 
	{
        LOG_ERR("bt_gatt_exchange_mtu failed (err %d)", err);
    }
}

static void update_data_length(struct bt_conn *conn)
{
    int err;

    struct bt_conn_le_data_len_param my_data_len = 
	{
        .tx_max_len = BT_GAP_DATA_LEN_MAX,
        .tx_max_time = BT_GAP_DATA_TIME_MAX,
    };

    err = bt_conn_le_data_len_update(conn, &my_data_len);
    if (err) 
	{
        LOG_ERR("data_len_update failed (err %d)", err);
    }
}

static void on_le_phy_updated(struct bt_conn *conn, struct bt_conn_le_phy_info *param)
{
    if (param->tx_phy == BT_CONN_LE_TX_POWER_PHY_1M)
	{
        LOG_INF("PHY updated. New PHY: 1M");
    }
    else if (param->tx_phy == BT_CONN_LE_TX_POWER_PHY_2M) 
	{
        LOG_INF("PHY updated. New PHY: 2M");
    }
    else if (param->tx_phy == BT_CONN_LE_TX_POWER_PHY_CODED_S8) 
	{
        LOG_INF("PHY updated. New PHY: Long Range");
    }
}

static void update_phy(struct bt_conn *conn)
{
    int err;

    const struct bt_conn_le_phy_param preferred_phy = 
	{
        .options = BT_CONN_LE_PHY_OPT_NONE,
        .pref_rx_phy = BT_GAP_LE_PHY_2M,
        .pref_tx_phy = BT_GAP_LE_PHY_2M,
    };

    err = bt_conn_le_phy_update(conn, &preferred_phy);
    if (err) 
	{
        LOG_ERR("bt_conn_le_phy_update() returned %d", err);
    }
}

static void on_connected(struct bt_conn *conn, uint8_t err)
{
	if (err) 
	{
		LOG_INF("Connection failed (err %u)\n", err);
		return;
	}

	struct bt_conn_info info;
	err = bt_conn_get_info(conn, &info);

	uint32_t connection_interval_ms = info.le.interval * 1.25;
	uint16_t supervision_timeout_ms = info.le.timeout * 10;
	LOG_INF("Connection parameters: interval %d ms, latency %d intervals, timeout %d ms", 	\
						connection_interval_ms, info.le.latency, supervision_timeout_ms);

	LOG_INF("Connected");
	k_sleep(K_MSEC(1000));		/* Wait for connection process to fully complete */
	update_phy(conn);
	update_data_length(conn);
	update_mtu(conn);
}

static void on_disconnected(struct bt_conn *conn, uint8_t reason)
{
	LOG_INF("Disconnected (reason %u)\n", reason);
	advetising_start();
}

static void on_security_changed(struct bt_conn *conn, bt_security_t level,
                                enum bt_security_err err)
{
    char addr[BT_ADDR_LE_STR_LEN];

    bt_addr_le_to_str(bt_conn_get_dst(conn), addr, sizeof(addr));

    if (!err) 
    {
        LOG_INF("Security changed: %s level %u\n", addr, level);
    } 
    else 
    {
        LOG_INF("Security failed: %s level %u err %d\n", addr, level, err);
    }
}

static void on_le_param_updated(struct bt_conn *conn, uint16_t interval, uint16_t latency, uint16_t timeout)
{
    uint32_t connection_interval_ms = interval * 1.25;         
    uint16_t supervision_timeout_ms = timeout * 10;          
    LOG_INF("Connection parameters updated: interval %d ms, latency %d intervals, timeout %d ms", 
				connection_interval_ms, latency, supervision_timeout_ms);
}
```

## src/gatt_lock_svc.c
```c
/*
 * Copyright (c) 2018 Nordic Semiconductor ASA
 *
 * SPDX-License-Identifier: LicenseRef-Nordic-5-Clause
 */

/** @file
 *  @brief LED Button Service (LBS) sample
 */

#include <zephyr/types.h>
#include <stddef.h>
#include <string.h>
#include <errno.h>
#include <zephyr/sys/printk.h>
#include <zephyr/sys/byteorder.h>
#include <zephyr/kernel.h>

#include <zephyr/bluetooth/bluetooth.h>
#include <zephyr/bluetooth/hci.h>
#include <zephyr/bluetooth/conn.h>
#include <zephyr/bluetooth/uuid.h>
#include <zephyr/bluetooth/gatt.h>

#include "gatt_lock_svc.h"

#include <zephyr/logging/log.h>

LOG_MODULE_DECLARE(smart_door_lock);

static bool button_state;

static ssize_t write_led(struct bt_conn *conn,
			 const struct bt_gatt_attr *attr,
			 const void *buf,
			 uint16_t len, uint16_t offset, uint8_t flags)
{
	LOG_DBG("Attribute write, handle: %u, conn: %p", attr->handle,
		(void *)conn);

	if (len != 1U) {
		LOG_DBG("Write led: Incorrect data length");
		return BT_GATT_ERR(BT_ATT_ERR_INVALID_ATTRIBUTE_LEN);
	}

	if (offset != 0) {
		LOG_DBG("Write led: Incorrect data offset");
		return BT_GATT_ERR(BT_ATT_ERR_INVALID_OFFSET);
	}

	//Read the received value 
	uint8_t val = *((uint8_t *)buf);

	if (val == 0x00 || val == 0x01) {
		//Call the application callback function to update the LED state
		//lbs_cb.led_cb(val ? true : false);
	} else {
		LOG_DBG("Write led: Incorrect value");
		return BT_GATT_ERR(BT_ATT_ERR_VALUE_NOT_ALLOWED);
	}

	return len;
}


static ssize_t read_button(struct bt_conn *conn,
			  const struct bt_gatt_attr *attr,
			  void *buf,
			  uint16_t len,
			  uint16_t offset)
{
	//get a pointer to button_state which is passed in the BT_GATT_CHARACTERISTIC() and stored in attr->user_data
	const char *value = attr->user_data;

	LOG_DBG("Attribute read, handle: %u, conn: %p", attr->handle,
		(void *)conn);


	return bt_gatt_attr_read(conn, attr, buf, len, offset, value,
					sizeof(*value));
	
}

/* Lock Service Declaration */
BT_GATT_SERVICE_DEFINE(
	lock_svc, BT_GATT_PRIMARY_SERVICE(BT_UUID_LOCK),
	BT_GATT_CHARACTERISTIC(BT_UUID_LOCK_PIN,
			       BT_GATT_CHRC_WRITE,
			       BT_GATT_PERM_READ_ENCRYPT ,
			       NULL, write_led, NULL),
	BT_GATT_CHARACTERISTIC(BT_UUID_LOCK_STATE,
			       BT_GATT_CHRC_READ,
			       BT_GATT_PERM_READ_ENCRYPT , read_button, NULL,
			       &button_state),

);
```

## src/gatt_lock_svc.h
```c
/*
 * Copyright (c) 2018 Nordic Semiconductor ASA
 *
 * SPDX-License-Identifier: LicenseRef-Nordic-5-Clause
 */

#ifndef BT_LBS_H_
#define BT_LBS_H_

/**@file
 * @defgroup bt_lock_svc Lock Service API
 * @{
 * @brief API for the Lock Service.
 */

#ifdef __cplusplus
extern "C" {
#endif

#include <zephyr/types.h>
#include <zephyr/bluetooth/uuid.h>


#define BT_UUID_LOCK_VAL	\
	BT_UUID_128_ENCODE(0x1c376f00, 0x468f, 0xEFDE, 0x8652, 0x4183255a1de3)

#define BT_UUID_LOCK_PIN_VAL \
	BT_UUID_128_ENCODE(0x1c376f01, 0x468f, 0xEFDE, 0x8652, 0x4183255a1de3)

#define BT_UUID_LOCK_STATE_VAL \
	BT_UUID_128_ENCODE(0x1c376f02, 0x468f, 0xEFDE, 0x8652, 0x4183255a1de3)

#define BT_UUID_LOCK           BT_UUID_DECLARE_128(BT_UUID_LOCK_VAL)
#define BT_UUID_LOCK_PIN    BT_UUID_DECLARE_128(BT_UUID_LOCK_PIN_VAL)
#define BT_UUID_LOCK_STATE       BT_UUID_DECLARE_128(BT_UUID_LOCK_STATE_VAL)

/** @brief Callback type for when an LED state change is received. */
typedef void (*led_cb_t)(const bool led_state);

/** @brief Callback type for when the button state is pulled. */
typedef bool (*button_cb_t)(void);

/** @brief Callback struct used by the LBS Service. */
struct my_lbs_cb {
	/** LED state change callback. */
	led_cb_t led_cb;
	/** Button read callback. */
	button_cb_t button_cb;
};

/** @brief Initialize the LBS Service.
 *
 * This function registers application callback functions with the My LBS
 * Service
 *
 * @param[in] callbacks Struct containing pointers to callback functions
 *			used by the service. This pointer can be NULL
 *			if no callback functions are defined.
 *
 *
 * @retval 0 If the operation was successful.
 *           Otherwise, a (negative) error code is returned.
 */
int my_lbs_init(struct my_lbs_cb *callbacks);

#ifdef __cplusplus
}
#endif

/**
 * @}
 */

#endif /* BT_LBS_H_ */
```

## src/security.c
```c
#include <zephyr/kernel.h>
#include <zephyr/logging/log.h>
#include <zephyr/bluetooth/bluetooth.h>
#include <zephyr/bluetooth/conn.h>

#include "security.h"


LOG_MODULE_REGISTER(security);


extern struct k_msgq device_message_queue;
extern struct k_sem my_sem; 


static void auth_cancel(struct bt_conn *conn);
static void auth_passkey_entry(struct bt_conn *conn);
static void auth_passkey_confirm(struct bt_conn *conn);
enum bt_security_err pairing_accept_cb(struct bt_conn *conn, const struct 
                                        bt_conn_pairing_feat *const feat);


struct bt_conn_auth_cb conn_auth_callbacks = 
{
	.pairing_accept = NULL,
	.passkey_display = NULL,
	.passkey_confirm = NULL,
	.passkey_entry = NULL,
	.cancel = auth_cancel,
};


static void auth_cancel(struct bt_conn *conn)
{
	char addr[BT_ADDR_LE_STR_LEN];
	bt_addr_le_to_str(bt_conn_get_dst(conn), addr, sizeof(addr));
	LOG_INF("Pairing cancelled: %s\n", addr);
}

static void auth_passkey_entry(struct bt_conn *conn)
{
	LOG_INF("Passkey");

	int err;
	uint16_t temp;
	uint32_t passkey = 0;

	for(int i = 0; i < 6; ++i)
	{
		err = k_msgq_get(&device_message_queue, &temp, K_FOREVER);

		passkey = (temp - 48) * pow(10, 5 - i) + passkey;

		if(err == 0)
		{
			LOG_INF("Button Pressed: %c", (char)temp);
		}
	}

	LOG_INF("Passkey is: %d", passkey);

	err = bt_conn_auth_passkey_entry(conn, passkey);
	if(err != 0)
	{
		LOG_INF("Error on passkey entry: %d", err);
	}
		
}

static void auth_passkey_confirm(struct bt_conn *conn)
{

}

enum bt_security_err pairing_accept_cb(struct bt_conn *conn, const struct bt_conn_pairing_feat *const feat)
{
	if(feat->io_capability == BT_IO_NO_INPUT_OUTPUT)
	{
		LOG_INF("JUST WORKS, DO NOT ALLOW");
		return BT_SECURITY_ERR_PAIR_NOT_ALLOWED;
	}

	return 0;
}
```
